## boards/arm/gy79/Kconfig.board
```kconfig
# GY79 board configuration

# Copyright (c) 2022 Polarity Works
# SPDX-License-Identifier: MIT

config BOARD_GY79
	bool "gy79"
	depends on SOC_NRF52840_QIAA
```

## boards/arm/gy79/Kconfig.defconfig
```kconfig
# Copyright (c) 2021 Polarity Works
# SPDX-License-Identifier: MIT

if BOARD_GY79

config BOARD
	default "gy79"

if USB

config USB_NRFX
	default y

config USB_DEVICE_STACK
	default y

endif # USB

config BT_CTLR
	default BT

config ZMK_BLE
	default y

config ZMK_USB
	default y

config ZMK_BATTERY_VOLTAGE_DIVIDER
	default y

config ZMK_KEYBOARD_NAME
	default "GY79"

endif # BOARD_GY79
```

## config/boards/shields/gy79/Kconfig.shield
```kconfig
# GY79 board configuration

# Copyright (c) 2022 Polarity Works
# SPDX-License-Identifier: MIT

config SHIELD_BOARD_GY79
	select SOC_NRF52840_QIAA
	imply RETAINED_MEM
	imply RETENTION
	imply RETENTION_BOOT_MODE
```

## config/west.yml
```yaml
manifest:
  defaults:
    revision: v0.3
  remotes:
    - name: zmkfirmware
      url-base: https://github.com/zmkfirmware
    # Additional modules containing boards/shields/custom code can be listed here as well
    # See https://docs.zephyrproject.org/3.2.0/develop/west/manifest.html#projects
  projects:
    - name: gy79-module
      url: https://github.com/lingmingxi/zmk-config-gy79
      revision: main
      clone-depth: 1
    - name: zmk
      remote: zmkfirmware
      revision: main
      import: app/west.yml
  self:
    path: config
    
```
